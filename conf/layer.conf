## conf/layer.conf
```bitbake
# We have a conf and classes directory, add to BBPATH
BBPATH .= ":${LAYERDIR}"

# We have a recipes-* directories, add to BBFILES
BBFILES += "${LAYERDIR}/recipes-*/*/*.bb \
	${LAYERDIR}/recipes-*/*/*.bbappend"

BBFILE_COLLECTIONS += "meta-st-demo-aws"
BBFILE_PATTERN_meta-st-demo-aws := "^${LAYERDIR}/"
BBFILE_PRIORITY_meta-st-demo-aws = "12"

EULA_FILE_ST_stm32mpcommonaws = "${LAYERDIR}/conf/eula/${MACHINE}"
EULA_FILE_ST_MD5SUM_stm32mpcommonaws = "8b505090fb679839cefbcc784afe8ce9"

#Inform bitbake for adding another location to search for licenses
LICENSE_PATH += "${LAYERDIR}/files/licenses"

# Set a variable to get the STM32MP MX BSP location
STM32MP_DEMO_AWS_BASE = "${LAYERDIR}"

# This should only be incremented on significant changes that will
# cause compatibility issues with other layers
LAYERVERSION_meta-st-demo-aws = "1"
LAYERSERIES_COMPAT_meta-st-demo-aws = "thud"

LAYERDEPENDS_meta-st-demo-aws = "stm-st-stm32mp"
```

## conf/machine/stm32mp1-demo-aws.conf
```bitbake
#@TYPE: Machine
#@NAME: stm32mp1-demo-aws
#@DESCRIPTION: Configuration for STM32MP1-DK2 board with Amazon Web Service demo
#@NEEDED_BSPLAYERS: layers/meta-openembedded/meta-oe layers/meta-openembedded/meta-python layers/meta-st/meta-st-stm32mp-addons

include conf/machine/include/st-machine-common-stm32mp.inc
include conf/machine/include/stm32mp1-mx-config.inc
include conf/machine/include/stm32mp1-mx-extlinux-config.inc
include conf/machine/include/stm32mp1-mx-common.inc

# Define specific common machine name
MACHINEOVERRIDES .= ":stm32mpcommonaws"

# =========================================================================
# CubeMX extra config
# =========================================================================
# Set specific path by components for DT file location
CUBEMX_DTB_PATH_pn-tf-a-stm32mp   = "${STM32MP_DEMO_AWS_BASE}/mx/${CUBEMX_PROJECT}/tf-a"
CUBEMX_DTB_PATH_pn-u-boot-stm32mp = "${STM32MP_DEMO_AWS_BASE}/mx/${CUBEMX_PROJECT}/u-boot"
CUBEMX_DTB_PATH_pn-linux-stm32mp  = "${STM32MP_DEMO_AWS_BASE}/mx/${CUBEMX_PROJECT}/kernel"

# Boot Mode Choice
# =========================================================================
# boot scheme (basic or trusted or optee)
# =========================================================================
BOOTSCHEME_LABELS = "trusted"

# Boot Device Choice
# =========================================================================
# flashlayout
# DISCO : sdcard
# EVAL : sdcard or emmc or nand-4-256 or nor-sdcard or nor-emmc or nor-nand-4-256
# =========================================================================
# Define the config labels to use to generate flashlayout file
FLASHLAYOUT_CONFIG_LABELS = "sdcard"

# Board Type Choice
# =========================================================================
# Assign CubeMX Board DT and project name
CUBEMX_DTB = "stm32mp157c-demo-aws-mx"
CUBEMX_PROJECT = "STM32MP157C-DK2/DeviceTree/"

# Define the original board devicetree : stm32mp157a-dk1 or stm32mp157c-dk2 or stm32mp157c-ev1
CUBEMX_DT_FILE_BASE = "stm32mp157c-dk2"
```
